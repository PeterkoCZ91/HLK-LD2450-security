R"WEBI18N(<script>
// --- i18n CZ/EN ---
const I18N = {
  cs: {
    title: "LD2450 Zabezpečení",
    default_pass_warn: "⚠️ Výchozí heslo admin/admin — změňte v sekci Síť",
    arm: "STŘEŽIT", disarm: "ZRUŠIT", cancel: "ZRUŠIT",
    disarmed: "🔓 NESTŘEŽENO", arming: "⏳ AKTIVUJI…", armed: "🔒 STŘEŽENO",
    pending: "⚠️ ČEKÁNÍ", triggered: "🚨 POPLACH!",
    targets: "CÍLE", state_idle: "KLID", state_detected: "DETEKCE", state_offline: "OFFLINE",
    sensor_health: "Zdraví senzoru", fps: "FPS", uart_errors: "UART chyby",
    ram_free: "RAM (volná)", uptime: "Doba běhu", wifi_rssi: "WiFi RSSI",
    entry_exit: "Vstup / Výstup", movement: "Pohyb", btn_restart: "Restart",
    radar_map: "RADAROVÁ MAPA",
    legend_target: "Cíl", legend_ghost: "Duch", legend_noise: "Šum",
    legend_polygon: "Polygon", legend_blackout: "Blackout",
    debug_view: "Debug (duchové &amp; šum)",
    tab_radar: "Radar", tab_alarm: "Alarm", tab_zones: "Zóny",
    tab_network: "Síť", tab_log: "Log", tab_system: "Systém",
    device_name: "Název zařízení (mDNS)",
    rotation: "Rotace", rotation_unit: "°",
    width: "Šířka (+/- mm)", range: "Dosah (mm)",
    section_filtering: "FILTRACE",
    min_target_size: "Min. velikost cíle", static_energy: "Statická energie",
    ghost_timeout: "Timeout duchů", move_threshold: "Práh pohybu",
    pos_threshold: "Práh pozice",
    section_alarm_delay: "ZPOŽDĚNÍ ALARMU",
    entry_delay: "Zpoždění vstupu (s)", exit_delay: "Zpoždění výstupu (s)",
    disarm_reminder: "Připomínka „Stále NESTŘEŽENO\"",
    section_antimask: "ANTI-MASKING (zakrytí senzoru)",
    antimask_alert: "Upozornění při zakrytí",
    timeout_s: "Timeout (s)",
    section_loiter: "POBÝVÁNÍ", loiter_alert: "Upozornění při pobývání",
    section_heartbeat: "SRDEČNÍ TEP", interval_h: "Interval (hodiny)",
    section_wifi_sec: "WIFI BEZPEČNOST",
    rssi_threshold: "Práh RSSI (dBm)", rssi_drop: "Max. pokles RSSI (dB)",
    section_schedule: "ROZVRH",
    auto_arm_at: "Auto střežení v", auto_disarm_at: "Auto odstřežení v",
    auto_arm_idle: "Auto-střežení po nečinnosti (min)",
    btn_save_schedule: "Uložit rozvrh",
    section_night_profile: "NOČNÍ PROFIL ZÓN",
    night_help: "Časy přepnutí den/noc profilu (prázdné = stále den).",
    night_start: "Začátek noci", night_end: "Konec noci",
    active_profile: "Aktivní profil",
    profile_day: "DEN", profile_night: "NOC",
    section_polygons: "POLYGONOVÉ ZÓNY",
    poly_help: "Stoupněte do rohu a klikněte pro přidání bodu.",
    poly_profile_note: "Polygony jsou aktivní v obou profilech (zatím beze změny).",
    zone1_point: "Zóna 1 — bod", zone2_point: "Zóna 2 — bod",
    del_zone1: "Smazat zónu 1", del_zone2: "Smazat zónu 2",
    section_blackout: "BLACKOUT ZÓNY",
    blackout_help: "Vyloučené oblasti (HVAC, antény).",
    draw_off: "Kreslení: VYP", draw_on: "Kreslení: ZAP",
    draw_help: "Klikněte a táhněte na mapě pro vytvoření blackout zóny.",
    add_manual: "+ Přidat ručně",
    section_tripwire: "TRIPWIRE (vstup/výstup)",
    tripwire_enable: "Zapnout tripwire", tripwire_y: "Pozice linie Y (mm)",
    btn_reset_counter: "Reset počítadla",
    section_region_filter: "FILTR REGIONU V RADARU (HW)",
    region_help: "Filtr přímo v radaru (cmd 0xC2). Cíle mimo zóny se neposílají přes UART. Komplementární k SW polygonům.",
    rf_mode: "Režim", rf_disabled: "Vypnuto",
    rf_detect: "Pouze detekovat", rf_exclude: "Vyloučit",
    btn_save_rf: "Uložit region filter", rf_saved: "Region filter uložen",
    section_mqtt: "MQTT BROKER", status: "Stav",
    enable_mqtt: "Zapnout MQTT", btn_save_mqtt: "Uložit MQTT",
    section_backup_wifi: "ZÁLOŽNÍ WIFI", btn_save_wifi: "Uložit WiFi",
    enable_bot: "Zapnout bota", bot_token: "Token bota",
    btn_save: "Uložit", btn_test: "Test",
    section_login: "PŘIHLÁŠENÍ",
    new_password: "Nové heslo", pass_confirm: "Potvrzení hesla",
    btn_change_pass: "Změnit heslo",
    section_events: "POSLEDNÍ UDÁLOSTI",
    btn_clear: "Vymazat",
    table_time: "Čas", table_type: "Typ", table_message: "Zpráva",
    no_events: "Žádné události",
    section_device_info: "INFORMACE O ZAŘÍZENÍ",
    device_id: "ID zařízení", ip_address: "IP adresa",
    mac_esp: "MAC adresa (ESP)", mac_radar: "MAC adresa (radar)", firmware: "Firmware",
    section_radar_ble: "RADAR BLE (BEZPEČNOST)",
    ble_warn: "Modul LD2450 má vlastní BLE konfigurační rozhraní (neautentizované). Pro snížení útočné plochy doporučuji vypnout.",
    btn_disable_ble: "Vypnout BLE radaru", btn_enable_ble: "Zapnout BLE radaru",
    section_noise_ai: "KALIBRACE POZADÍ",
    noise_help: "Nechte senzor 1 h v prázdné místnosti, naučí se ignorovat statické pozadí (duchy).",
    learning_status: "STAV UČENÍ", inactive: "Neaktivní",
    samples_label: "Vzorky", time_label: "Čas",
    btn_start: "Spustit", btn_save_noise: "Uložit",
    enable_noise_filter: "Filtr na základě kalibrace",
    section_ota: "AKTUALIZACE FW (OTA)", btn_upload_fw: "Nahrát firmware",
    section_backup_restore: "ZÁLOHA &amp; OBNOVA",
    btn_export: "Export", btn_import: "Import",
    running: "BĚŽÍ…", starts_in: "ZAČÍNÁ ZA", filter_active: "FILTR AKTIVNÍ", ready: "Připraveno",
    mqtt_connected: "Připojeno k", mqtt_disconnected: "Odpojeno",
    err: "Chyba", ok: "OK", saved: "Uloženo",
    counter_reset: "Počítadlo vynulováno",
    tripwire_saved: "Tripwire uloženo", schedule_saved: "Rozvrh uložen",
    telegram_ok: "Telegram OK!",
    fill_fields: "Vyplňte všechna pole", pass_mismatch: "Hesla se neshodují",
    creds_saved: "Údaje uloženy. Restartuji…",
    confirm_enable_ble: "Zapnout BLE rozhraní radaru? (zvyšuje útočnou plochu)",
    confirm_disable_ble: "Vypnout BLE radaru? (radar se nakrátko restartuje)",
    min_zone_size: "Min. 200×200 mm",
    prompt_name: "Název:", default_blackout_name: "Blackout zóna",
    zone_added: "Zóna přidána",
    confirm_delete: "Smazat?", deleted: "Smazáno",
    disabled: "Vypnuto", enabled: "Zapnuto",
    no_blackout: "Žádné blackout zóny",
    confirm_clear_poly: "Vymazat polygon?", cleared: "Vymazáno",
    confirm_clear_events: "Vymazat historii událostí?",
    prompt_x_min: "X min (mm):", prompt_x_max: "X max (mm):",
    prompt_y_min: "Y min (mm):", prompt_y_max: "Y max (mm):",
    ota_done: "Hotovo! Restartuji…", ota_error: "Chyba!",
    confirm_overwrite: "Přepsat konfiguraci? Zařízení se restartuje.",
    uploading: "Nahrávám…", loading: "NAČÍTÁM…",
  },
  en: {
    title: "LD2450 Security",
    default_pass_warn: "⚠️ Default password admin/admin — change in Network section",
    arm: "ARM", disarm: "DISARM", cancel: "CANCEL",
    disarmed: "🔓 DISARMED", arming: "⏳ ARMING…", armed: "🔒 ARMED",
    pending: "⚠️ PENDING", triggered: "🚨 TRIGGERED!",
    targets: "TARGETS", state_idle: "IDLE", state_detected: "DETECTED", state_offline: "OFFLINE",
    sensor_health: "Sensor Health", fps: "FPS", uart_errors: "UART Errors",
    ram_free: "RAM (Free)", uptime: "Uptime", wifi_rssi: "WiFi RSSI",
    entry_exit: "Entry / Exit", movement: "Motion", btn_restart: "Restart",
    radar_map: "RADAR MAP",
    legend_target: "Target", legend_ghost: "Ghost", legend_noise: "Noise",
    legend_polygon: "Polygon", legend_blackout: "Blackout",
    debug_view: "Debug (Ghosts &amp; Noise)",
    tab_radar: "Radar", tab_alarm: "Alarm", tab_zones: "Zones",
    tab_network: "Network", tab_log: "Log", tab_system: "System",
    device_name: "Device Name (mDNS)",
    rotation: "Rotation", rotation_unit: "°",
    width: "Width (+/- mm)", range: "Range (mm)",
    section_filtering: "FILTERING",
    min_target_size: "Min target size", static_energy: "Static energy",
    ghost_timeout: "Ghost timeout", move_threshold: "Motion threshold",
    pos_threshold: "Position threshold",
    section_alarm_delay: "ALARM DELAY",
    entry_delay: "Entry delay (s)", exit_delay: "Exit delay (s)",
    disarm_reminder: "Remind \"Still DISARMED\"",
    section_antimask: "ANTI-MASKING (sensor masking)",
    antimask_alert: "Alert on masking",
    timeout_s: "Timeout (s)",
    section_loiter: "LOITERING", loiter_alert: "Alert on loitering",
    section_heartbeat: "HEARTBEAT", interval_h: "Interval (hours)",
    section_wifi_sec: "WIFI SECURITY",
    rssi_threshold: "RSSI threshold (dBm)", rssi_drop: "Max RSSI drop (dB)",
    section_schedule: "SCHEDULE",
    auto_arm_at: "Auto arm at", auto_disarm_at: "Auto disarm at",
    auto_arm_idle: "Auto-arm after inactivity (min)",
    btn_save_schedule: "Save schedule",
    section_night_profile: "NIGHT ZONE PROFILE",
    night_help: "Day/night profile switch times (empty = always day).",
    night_start: "Night start", night_end: "Night end",
    active_profile: "Active profile",
    profile_day: "DAY", profile_night: "NIGHT",
    section_polygons: "POLYGON ZONES",
    poly_help: "Stand in corner and click to add point.",
    poly_profile_note: "Polygons are active in both profiles (not yet configurable).",
    zone1_point: "Zone 1 — point", zone2_point: "Zone 2 — point",
    del_zone1: "Delete zone 1", del_zone2: "Delete zone 2",
    section_blackout: "BLACKOUT ZONES",
    blackout_help: "Excluded areas (HVAC, antennas).",
    draw_off: "Drawing: OFF", draw_on: "Drawing: ON",
    draw_help: "Click and drag on map to create blackout zone.",
    add_manual: "+ Add manual",
    section_tripwire: "TRIPWIRE (entry/exit)",
    tripwire_enable: "Enable tripwire", tripwire_y: "Line Y position (mm)",
    btn_reset_counter: "Reset counter",
    section_region_filter: "RADAR REGION FILTER (HW)",
    region_help: "Filter directly in radar (cmd 0xC2). Targets outside zones never reach UART. Complementary to SW polygons.",
    rf_mode: "Mode", rf_disabled: "Disabled",
    rf_detect: "Detect only", rf_exclude: "Exclude",
    btn_save_rf: "Save region filter", rf_saved: "Region filter saved",
    section_mqtt: "MQTT BROKER", status: "Status",
    enable_mqtt: "Enable MQTT", btn_save_mqtt: "Save MQTT",
    section_backup_wifi: "BACKUP WIFI", btn_save_wifi: "Save WiFi",
    enable_bot: "Enable bot", bot_token: "Bot token",
    btn_save: "Save", btn_test: "Test",
    section_login: "LOGIN",
    new_password: "New password", pass_confirm: "Password confirmation",
    btn_change_pass: "Change password",
    section_events: "RECENT EVENTS",
    btn_clear: "Clear",
    table_time: "Time", table_type: "Type", table_message: "Message",
    no_events: "No events",
    section_device_info: "DEVICE INFORMATION",
    device_id: "Device ID", ip_address: "IP address",
    mac_esp: "MAC address (ESP)", mac_radar: "MAC address (radar)", firmware: "Firmware",
    section_radar_ble: "RADAR BLE (SECURITY)",
    ble_warn: "LD2450 module has its own BLE configuration interface (unauthenticated). To reduce attack surface I recommend disabling it.",
    btn_disable_ble: "Disable radar BLE", btn_enable_ble: "Enable radar BLE",
    section_noise_ai: "BACKGROUND CALIBRATION",
    noise_help: "Leave the sensor 1 h in an empty room. It learns to ignore static background (ghosts).",
    learning_status: "LEARNING STATUS", inactive: "Inactive",
    samples_label: "Samples", time_label: "Time",
    btn_start: "Start", btn_save_noise: "Save",
    enable_noise_filter: "Use calibrated background filter",
    section_ota: "FIRMWARE UPDATE (OTA)", btn_upload_fw: "Upload firmware",
    section_backup_restore: "BACKUP &amp; RESTORE",
    btn_export: "Export", btn_import: "Import",
    running: "RUNNING…", starts_in: "STARTS IN", filter_active: "FILTER ACTIVE", ready: "Ready",
    mqtt_connected: "Connected to", mqtt_disconnected: "Disconnected",
    err: "Error", ok: "OK", saved: "Saved",
    counter_reset: "Counter reset",
    tripwire_saved: "Tripwire saved", schedule_saved: "Schedule saved",
    telegram_ok: "Telegram OK!",
    fill_fields: "Fill in all fields", pass_mismatch: "Passwords do not match",
    creds_saved: "Credentials saved. Restarting…",
    confirm_enable_ble: "Enable radar BLE interface? (increases attack surface)",
    confirm_disable_ble: "Disable radar BLE? (radar will briefly restart)",
    min_zone_size: "Min 200×200 mm",
    prompt_name: "Name:", default_blackout_name: "Blackout Zone",
    zone_added: "Zone added",
    confirm_delete: "Delete?", deleted: "Deleted",
    disabled: "Disabled", enabled: "Enabled",
    no_blackout: "No blackout zones",
    confirm_clear_poly: "Clear polygon?", cleared: "Cleared",
    confirm_clear_events: "Clear event history?",
    prompt_x_min: "X Min (mm):", prompt_x_max: "X Max (mm):",
    prompt_y_min: "Y Min (mm):", prompt_y_max: "Y Max (mm):",
    ota_done: "Done! Restarting…", ota_error: "Error!",
    confirm_overwrite: "Overwrite configuration? Device will restart.",
    uploading: "Uploading…", loading: "LOADING…",
  }
};
)WEBI18N"
